// SPDX-License-Identifier: BSD-3-Clause
/*
 * Copyright (c) Qualcomm Technologies, Inc. and/or its subsidiaries.
 * Module-specific DTS for qcom,kerap-qmb
 */

/dts-v1/;
/plugin/;

#include "kera-qca6750-bt.dtsi"

/ {
	model = "Qualcomm Technologies, Inc. Kera QMB";
	compatible = "qcom,kerap-qmb";
	qcom,msm-id = <720 0x10000>;
	qcom,board-id = <0x000021 0>, <0x010001 0>, <0x020001 0>,
					<0x030001 0>, <0x040001 0>, <0x010008 0>,
					<0x020008 0>, <0x030008 0>, <0x010015 0>,
					<0x020015 0>, <0x030015 0>, <0x03000B 1>,
					<0x050001 0>, <0x010001 1>;
};

// FM changes - not needed for qmb module, completely remove FM device
&qupv3_se4_i2c {
	status = "disabled";
	/delete-node/ nq@64;
};
