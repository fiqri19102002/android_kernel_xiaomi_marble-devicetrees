// SPDX-License-Identifier: BSD-3-Clause

/*
 * Copyright (c) 2024 Qualcomm Innovation Center, Inc. All rights reserved.
 */

/dts-v1/;
/plugin/;

#include "parrot-nfc-common.dtsi"

/ {
	model = "Qualcomm Technologies, Inc. Parrot ATP";
	compatible = "qcom,parrot-atp", "qcom,parrot", "qcom,atp";
	qcom,msm-id = <663 0x10000>;
	qcom,board-id = <33 0>;
};
