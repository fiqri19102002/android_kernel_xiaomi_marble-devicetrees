// SPDX-License-Identifier: BSD-3-Clause

/*
 * Copyright (c) 2024 Qualcomm Innovation Center, Inc. All rights reserved.
 */

/dts-v1/;
/plugin/;

#include "parrot-nfc-common.dtsi"

/ {
	model = "Qualcomm Technologies, Inc. Parrot QRD";
	compatible = "qcom,parrot-qrd", "qcom,parrot", "qcom,qrd";
	qcom,msm-id = <663 0x10000>;
	qcom,board-id = <0x1000B 0>;
};

