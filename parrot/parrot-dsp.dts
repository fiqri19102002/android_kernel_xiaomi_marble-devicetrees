// SPDX-License-Identifier: BSD-3-Clause
/*
 * Copyright (c) 2024 Qualcomm Innovation Center, Inc. All rights reserved.
 */
/dts-v1/;
/plugin/;

#include "parrot-dsp.dtsi"

/ {
	model = "Qualcomm Technologies, Inc. sun v1 SoC";
	compatible = "qcom,parrot";
	qcom,board-id = <0 0>;
};
