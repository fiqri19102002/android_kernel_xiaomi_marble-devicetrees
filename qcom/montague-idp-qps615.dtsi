#include "montague-hsp.dtsi"

&qupv3_se0_i2c {
	status = "ok";

	pcie0_i2c_ctrl: pcie0_i2c_ctrl {
		compatible = "qcom,pcie-i2c-ntn3";
		rc-index = <0x0>;
		reg = <0x77>;
		gpio-config-reg = <0x801208>;
		ep-reset-reg = <0x801210>;
		ep-reset-gpio-mask = <0xc>;
		version-reg = <0x800000>;
		dump-regs = <0x801330 0x801350 0x801370>;
		reg_update = <0x82c030 0x1
					0x828000 0x3
					0x82bd00 0x8
					0x82c030 0x2
					0x828000 0x3
					0x82bd00 0x8
					0x82c030 0x8
					0x828000 0x1
					0x82bd00 0x8
					0x82c01c 0x10
					0x82c030 0xf
					0x828000 0xf
					0x82b268 0x2>;
		/*FOM for preset caluclation*/
		switch_reg_update = <0x82c02c 0x00000007
					0x824a10 0x00000001
					0x82c030 0x00000008
					0x828000 0x00000001
					0x82b074 0x00000020
					0x82b2bc 0x00000001>;
	};
};

&pcie0 {

	pcie-i2c-phandle = <&qupv3_se0_i2c>;
	qcom,boot-option = <0x2>;
	iommu-map = <0x0 &apps_smmu 0x1400 0x1>,
		<0x100 &apps_smmu 0x1401 0x1>,
		<0x208 &apps_smmu 0x1404 0x1>,
		<0x210 &apps_smmu 0x1405 0x1>,
		<0x218 &apps_smmu 0x1406 0x1>,
		<0x300 &apps_smmu 0x1407 0x1>,
		<0x400 &apps_smmu 0x1410 0x1>,
		<0x500 &apps_smmu 0x1411 0x1>,
		<0x501 &apps_smmu 0x1412 0x1>;
};

