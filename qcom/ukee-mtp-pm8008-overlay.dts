/dts-v1/;
/plugin/;

#include <dt-bindings/clock/qcom,camcc-waipio.h>
#include <dt-bindings/clock/qcom,gcc-waipio.h>
#include <dt-bindings/interconnect/qcom,waipio.h>
#include <dt-bindings/interrupt-controller/arm-gic.h>
#include <dt-bindings/regulator/qcom,rpmh-regulator-levels.h>

#include "ukee-mtp.dtsi"
#include "waipio-pm8008.dtsi"

#include "audio/ukee-audio-mtp.dtsi"
#include "camera/ukee-camera-sensor-mtp.dtsi"
#include "display/display/cape-sde-display-mtp.dtsi"

/ {
	model = "Qualcomm Technologies, Inc. Ukee MTP with PM8008";
	compatible = "qcom,ukee-mtp", "qcom,ukee", "qcom,mtp";
	qcom,msm-id = <591 0x10000>;
	qcom,board-id = <0x10008 0>;
};
