/* Copyright (c) Qualcomm Technologies, Inc. and/or its subsidiaries.
 * SPDX-License-Identifier: BSD-3-Clause-Clear
*/
/dts-v1/;
/plugin/;

#include "parrot-lite-audio-qrd.dtsi"

/ {
        model = "Qualcomm Technologies, Inc. Parrot-Lite QRD";
	compatible = "qcom,parrot-qrd", "qcom,parrot", "qcom,qrd";
        qcom,msm-id = <715 0x10000>;
        qcom,board-id = <0x1000B 0>, <0x1000B 1>, <0x1000B 2>,  <0x1000B 0x600>;
};
