/dts-v1/;
/plugin/;

#include <dt-bindings/interrupt-controller/arm-gic.h>
#include <dt-bindings/clock/qcom,gcc-sdm845.h>
#include <dt-bindings/clock/qcom,gpucc-sdm845.h>
#include <dt-bindings/clock/qcom,rpmh.h>
#include <dt-bindings/soc/qcom,rpmh-rsc.h>
#include <dt-bindings/regulator/qcom,rpmh-regulator-levels.h>
#include <dt-bindings/clock/qcom,aop-qmp.h>
#include <dt-bindings/interconnect/qcom,sdm670.h>

#include "sdm670-gpu.dtsi"
#include "qcs605-gpu-pwrlevels.dtsi"

/ {
	model = "Qualcomm Technologies, Inc. QCS605 SoC";
	compatible = "qcom,qcs605", "qcom,qcs605-mtp",
			"qcom,qcs605-cdp";
	qcom,msm-id = <347 0x0>;
	qcom,board-id = <0 0>, <1 0>, <8 0>;
};
